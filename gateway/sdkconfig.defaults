## gateway/sdkconfig.defaults
```kconfig
CONFIG_AUTOSTART_ARDUINO=y
CONFIG_FREERTOS_HZ=1000
CONFIG_ESP_TLS_PSK_VERIFICATION=y
CONFIG_ESPTOOLPY_FLASHSIZE_4MB=y
CONFIG_ESP_TLS_PSK_VERIFICATION=y
```

## node/sdkconfig.defaults
```kconfig
CONFIG_AUTOSTART_ARDUINO=y
CONFIG_FREERTOS_HZ=1000
CONFIG_LWIP_MAX_SOCKETS=15
#CONFIG_PTHREAD_TASK_STACK_SIZE_DEFAULT=8192
CONFIG_PARTITION_TABLE_CUSTOM=y
CONFIG_PARTITION_TABLE_CUSTOM_FILENAME="ndefault.csv"
CONFIG_PARTITION_TABLE_FILENAME="ndefault.csv"
CONFIG_ESPTOOLPY_FLASHSIZE_4MB=y
```
